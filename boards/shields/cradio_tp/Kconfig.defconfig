## boards/shields/cradio_tp/Kconfig.defconfig
```kconfig
# Copyright (c) 2020 The ZMK Contributors
# SPDX-License-Identifier: MIT

if SHIELD_CRADIO_TP_RIGHT

config ZMK_KEYBOARD_NAME
    default "Cradio TP"

config ZMK_SPLIT_ROLE_CENTRAL
    default y

endif

if SHIELD_CRADIO_TP_LEFT || SHIELD_CRADIO_TP_RIGHT

config ZMK_SPLIT
    default y

endif
```

## boards/shields/cradio_tp/Kconfig.shield
```kconfig
# Copyright (c) 2020 The ZMK Contributors
# SPDX-License-Identifier: MIT

config SHIELD_CRADIO_TP_LEFT
    def_bool $(shields_list_contains,cradio_tp_left)

config SHIELD_CRADIO_TP_RIGHT
    def_bool $(shields_list_contains,cradio_tp_right)
```
